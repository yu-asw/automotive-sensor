## labs/ros2-yocto/meta-yu-ros2/conf/layer.conf
```bitbake
BBPATH .= ":${LAYERDIR}"
BBFILES += "${LAYERDIR}/recipes-*/*/*.bb ${LAYERDIR}/recipes-*/*/*.bbappend"
BBFILE_COLLECTIONS += "yu-ros2"
BBFILE_PATTERN_yu-ros2 = "^${LAYERDIR}/"
BBFILE_PRIORITY_yu-ros2 = "15"
LAYERSERIES_COMPAT_yu-ros2 = "kirkstone"
LAYERDEPENDS_yu-ros2 = "core ros2-humble-layer"
```
